VERSION ""

NS_ :

BS_:

BU_: BenchTester

BO_ 654 Tester_RET2: 12 Vector__XXX

BO_ 1677 Tester_CFG: 16 BenchTester
 SG_ Disable_P2T_Output : 97|1@0+ (1,0) [0|15] "" Vector__XXX
 SG_ Disable_P1_Output : 98|1@0+ (1,0) [0|15] "" Vector__XXX
 SG_ Disable_Exhaust_I_Fdbk : 102|1@0+ (1,0) [0|15] "" Vector__XXX
 SG_ Disable_Damper4_I_Fdbk : 107|1@0+ (1,0) [0|15] "" Vector__XXX
 SG_ Disable_Damper3_I_Fdbk : 106|1@0+ (1,0) [0|15] "" Vector__XXX
 SG_ Disable_Damper2_I_Fdbk : 105|1@0+ (1,0) [0|15] "" Vector__XXX
 SG_ Disable_Damper1_I_Fdbk : 104|1@0+ (1,0) [0|1] "" Vector__XXX
 SG_ Disable_Compressor_I_Fdbk : 103|1@0+ (1,0) [0|15] "" Vector__XXX
 SG_ PS_Voltage_Set : 67|12@0+ (1,0) [0|4095] "V" Vector__XXX
 SG_ PS_Current_Limit_Set : 83|12@0+ (1,0) [0|4095] "I" Vector__XXX
 SG_ IGN_HW : 100|1@0+ (1,0) [0|15] "" Vector__XXX
 SG_ ECU_Relay : 96|1@0+ (1,0) [0|15] "" Vector__XXX
 SG_ Tester_PWM_Freq_RR : 54|15@0+ (1,0) [0|32767] "" Vector__XXX
 SG_ Tester_PWM_Freq_LR : 38|15@0+ (1,0) [0|32767] "" Vector__XXX
 SG_ Tester_PWM_Freq_RF : 22|15@0+ (1,0) [0|32767] "" Vector__XXX
 SG_ Tester_PWM_Freq_LF : 6|15@0+ (1,0) [0|32767] "" Vector__XXX

BO_ 398 Tester_RET: 20 Vector__XXX
 SG_ PS_Voltage_Read : 107|12@0+ (1,0) [0|4095] "V" Vector__XXX
 SG_ PS_Current_Read : 123|12@0+ (1,0) [0|4095] "I" Vector__XXX
 SG_ DIV_Fdbk : 0|1@0+ (1,0) [0|1] "" Vector__XXX
 SG_ BST_Fdbk : 1|1@0+ (1,0) [0|1] "" Vector__XXX
 SG_ RES2_Fdbk : 2|1@0+ (1,0) [0|1] "" Vector__XXX
 SG_ RES1_Fdbk : 3|1@0+ (1,0) [0|1] "" Vector__XXX
 SG_ RR_Fdbk : 4|1@0+ (1,0) [0|1] "" Vector__XXX
 SG_ LR_Fdbk : 5|1@0+ (1,0) [0|1] "" Vector__XXX
 SG_ RF_Fdbk : 6|1@0+ (1,0) [0|1] "" Vector__XXX
 SG_ LF_Fdbk : 7|1@0+ (1,0) [0|1] "" Vector__XXX
 SG_ Damper4_I_Fdbk : 95|16@0- (1,0) [-32768|32767] "mA" Vector__XXX
 SG_ Damper3_I_Fdbk : 79|16@0- (1,0) [-32768|32767] "mA" Vector__XXX
 SG_ Damper2_I_Fdbk : 63|16@0- (1,0) [-32768|32767] "mA" Vector__XXX
 SG_ Damper1_I_Fdbk : 47|16@0- (1,0) [-32768|32767] "mA" Vector__XXX
 SG_ Exh_I_Fdbk : 31|16@0- (1,0) [-32768|32767] "mA" Vector__XXX
 SG_ Comp_I_Fdbk : 15|16@0- (1,0) [-32768|32767] "mA" Vector__XXX

BO_ 397 Tester_CMD: 16 BenchTester
 SG_ Tester_PWM_DC_RR : 102|15@0+ (1,0) [0|32767] "" Vector__XXX
 SG_ Tester_PWM_DC_LR : 86|15@0+ (1,0) [0|32767] "" Vector__XXX
 SG_ Tester_PWM_DC_RF : 70|15@0+ (1,0) [0|32767] "" Vector__XXX
 SG_ Tester_PWM_DC_LF : 54|15@0+ (1,0) [0|32767] "" Vector__XXX
 SG_ Tester_Pressure_P2 : 19|12@0+ (1,0) [0|4095] "V" Vector__XXX
 SG_ Tester_Pressure_P1 : 3|12@0+ (1,0) [0|4095] "V" Vector__XXX
 SG_ Tester_Temperature : 35|12@0+ (1,0) [0|4095] "" Vector__XXX

BA_DEF_ BO_  "VFrameFormat" ENUM  "StandardCAN","ExtendedCAN","reserved","reserved","reserved","reserved","reserved","reserved","reserved","reserved","reserved","reserved","reserved","reserved","StandardCAN_FD","ExtendedCAN_FD";
BA_DEF_  "BusType" STRING ;
BA_DEF_DEF_  "VFrameFormat" "ExtendedCAN_FD";
BA_DEF_DEF_  "BusType" "";
BA_ "BusType" "CAN FD";
BA_ "VFrameFormat" BO_ 654 14;
BA_ "VFrameFormat" BO_ 1677 14;
BA_ "VFrameFormat" BO_ 398 14;
BA_ "VFrameFormat" BO_ 397 14;
